## uam_ctrl/Kconfig
```kconfig
menuconfig MODULES_UAM_CTRL
        bool "uam_ctrl"
        default n
        ---help---
                Enable Controller Parameters for Simulink App
```

## uam_obs/Kconfig
```kconfig
menuconfig MODULES_UAM_OBS
        bool "uam_obs"
        default n
        ---help---
                Enable Controller Parameters for Simulink App
```
